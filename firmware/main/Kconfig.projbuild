## firmware/main/Kconfig.projbuild
```kconfig
menu "Relay"

config UP_SSID
    string "WiFi to relay"
    default "Rutledge Flats Residents"

config UP_PASSWORD
    string "Password of the WiFi to relay"
    default ""

config AP_SSID
    string "Name of the relay network"
    default "ChangeNet"

config AP_PASSWORD
    string "Relay password (WPA2/WPA3)"
    default "12345nodefu"

config AP_MAX
    int "Most devices on the relay at once"
    default 8
    range 1 10

config LOG_LOOKUPS
    bool "Print every DNS lookup to the serial log"
    default n

endmenu
```

## firmware/sdkconfig.defaults
```kconfig
CONFIG_IDF_TARGET="esp32c6"
CONFIG_ESPTOOLPY_FLASHSIZE_4MB=y
CONFIG_PARTITION_TABLE_CUSTOM=y
CONFIG_PARTITION_TABLE_CUSTOM_FILENAME="partitions.csv"
CONFIG_LWIP_IP_FORWARD=y
CONFIG_LWIP_IPV4_NAPT=y
CONFIG_LWIP_MAX_SOCKETS=16
CONFIG_ESP_WIFI_SOFTAP_SAE_SUPPORT=y
CONFIG_ESP_WIFI_ENABLE_WPA3_SAE=y
```
